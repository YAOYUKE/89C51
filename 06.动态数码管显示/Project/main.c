#include <reg52.h>


/*************************************************************************
- Function    : 动态数码管实验
- Description : 数码管动态显示数字1-100
- Hardware    : 位选 - P2.7  段选 - P2.6
- Author      : Y.
- Date        : 2017.12
 *************************************************************************/
 
 
 /* 定义常用变量类型 */
typedef unsigned char u8;
typedef unsigned int u16;

/* 定义全局变量 */
u8 code table[] = {0x3f,0x06,0x5b,0x4f,                 // 共阴数码管码表
                   0x66,0x6d,0x7d,0x07,
                   0x7f,0x6f,0x77,0x7c,
                   0x39,0x5e,0x79,0x71};

u8 temp,bai,shi,ge,tt;
				   
/* 位变量声明 */
sbit dula = P2^6;                                       // 控制段选
sbit wela = P2^7;                                       // 控制位选

/* 声明子函数 */				   
void delay(u16);                                        // 延时函数
void display(u16,u16,u16);                              // 显示函数
void Timer_Init();                                      // 定时器初始化函数
				   

/*************************************************************************
 Function    : 主程序
 Description : None 
**************************************************************************/
void main()
{
	  						 
	Timer_Init();                                     // 定时器初始化
	
	while(1)
	{
		if(tt == 20)                                  // 5000us * 20 = 1s
		{
		
			tt = 0;
			temp++;
					 
			if(temp == 100)                           // 100s重置
			{
				temp = 0;
			}
						 
			bai = temp/100;                           // 分离百位
			shi = (temp%100)/10;                      // 分离十位
			ge = temp%10;                             // 分离个位
		}
		
		display(bai,shi,ge);	                      // 显示函数
	}
	
     
}


/*************************************************************************
 Function    : 延时子程序
 Description : 延时 x 毫秒(非精确延时)
**************************************************************************/
void delay(u16 xms)
{
    u16 x,y;
	for(x=xms;x>0;x--)
    {
	    for(y=125;y>0;y--);
	}
}


/*************************************************************************
 Function    : 数码管显示程序
 Description : 显示1-100
**************************************************************************/
void display(u16 bai,u16 shi,u16 ge)
{
	dula = 1;
	P0 = table[bai];                                // 百位
	dula = 0;

	wela = 1;
	P0 = 0xfe;
	wela = 0;
	
	delay(1);
	P0 = 0x00;

	dula = 1;
	P0 = table[shi];                                // 十位
	dula = 0;

	wela = 1;
	P0 = 0xfd;
	wela = 0;
		
	delay(1);
	P0 = 0x00;	

	dula = 1;
	P0 = table[ge];                                 // 个位
	dula = 0;

	wela = 1;
	P0 = 0xfb;
	wela = 0;
		
	delay(1);
	P0 = 0x00;
}


/*************************************************************************
 Function    : 定时器初始化
 Description : NONE
**************************************************************************/
void Timer_Init ()                               
{
	EA = 1;
	ET0 = 1;
	TMOD = 0x01;
	TH0 = (65536-50000)/256;
	TL0 = (65536-50000)%256;
	TR0 = 1;	
	
	temp = 0;
}


/*************************************************************************
 Function    : 定时器0
 Description : 控制数码管显示时间
**************************************************************************/
void timer0() interrupt 1
{
	TH0 = (65536-50000)/256;
	TL0 = (65536-50000)%256;
	tt++;
}