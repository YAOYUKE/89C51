#include "reg52.h"
#include "intrins.h"


/*************************************************************************
- Function    : 静态数码管实验
- Description : 8位数码管显示11111111 - FFFFFFFF
- Hardware    : 数码管 段选 -> P2.6  位选 -> P2.7
- Author      : Y.
- Date        : 2017.12
 *************************************************************************/


/* 定义常用变量类型 */
typedef unsigned char u8;
typedef unsigned int u16;

/* 定义全局变量 */
u8 code table[] = {0x3f,0x06,0x5b,0x4f,
                   0x66,0x6d,0x7d,0x07,
                   0x7f,0x6f,0x77,0x7c,
                   0x39,0x5e,0x79,0x71};
u8 num;

/* 位操作声明 */
sbit dula = P2^6;   //  控制段选
sbit wela = P2^7;   //  控制位选

/* 声明子函数 */
void delay(u16);
									 
									 
/*************************************************************************
 Function    : 主程序
 Description : None 
**************************************************************************/									 
void main()
{
	  wela = 1;                             // 打开位选
	  P0 = 0x00;                            // 位选8个数码管
	  wela = 0;                             // 关闭位选

	  while(1)
		{
			  for(num=0;num<16;num++)
			  {
				    dula = 1;                     // 打开段选
					  P0 = table[num];              // 送入显示数据
					  dula = 0;                     // 关闭段选
					  delay(1000);                  // 延时
				}
		}
	
     
}


/*************************************************************************
 Function    : 延时子程序
 Description : 延时 x 毫秒
**************************************************************************/
void delay(u16 xms)
{
    u16 x,y;
	  for(x=xms;x>0;x--)
	  {
		    for(y=125;y>0;y--);
		}
}