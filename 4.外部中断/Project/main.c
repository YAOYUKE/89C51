#include "reg52.h"
#include "intrins.h"


/*************************************************************************
- Function    : 外部中断实验
- Description : 按下Key 中断指示灯LED亮 数码管停止变动 松开Key LED熄灭 数码管继续变动
- Hardware    : Key - P3.2  LED - P1.0
- Author      : Y.
- Date        : 2017.12
 *************************************************************************/
 
 
 /* 定义常用变量类型 */
typedef unsigned char u8;
typedef unsigned int u16;

/* 定义全局变量 */
u8 code table[] = {0x3f,0x06,0x5b,0x4f,
                   0x66,0x6d,0x7d,0x07,
                   0x7f,0x6f,0x77,0x7c,
                   0x39,0x5e,0x79,0x71};
u8 num;

/* 位变量声明 */
sbit dula = P2^6;   // 控制段选
sbit wela = P2^7;   // 控制位选
sbit key = P3^2;    // 中断按钮
sbit led = P1^0;    // 中断状态指示灯					 

/* 声明子函数 */
void zhongduan0();
void display();									 
void delay(u16);

				   
/*************************************************************************
 Function    : 主程序
 Description : None 
**************************************************************************/
void main()
{
	
	EA = 1;             // 打开中断总开关
    EX0 = 1;            // 打开外部中断0 - INT0
    IT0 = 0;            // 设置INT0工作方式：0 低电平触发  1 下降沿触发
		
	display();

     
}


/*************************************************************************
 Function    : 数码管显示程序
 Description : 11111111 -> FFFFFFFF 快速变动
**************************************************************************/
void display()
{
	  wela = 1;
	  P0 = 0x00;
	  wela = 0;
	
	  while(1)
		{
			  for(num=0;num<16;num++)
			  {
					  led = 1;
					
				    dula = 1;
					  P0 = table[num];
					  dula = 0;
					  delay(100);
				}
		}
	
}


/*************************************************************************
 Function    : 延时子程序
 Description : 延时 x 毫秒
**************************************************************************/
void delay(u16 xms)
{
    u16 x,y;
	  for(x=xms;x>0;x--)
	  {
		    for(y=125;y>0;y--);
		}
}


/*************************************************************************
 Function    : 中断函数
 Description : NONE
**************************************************************************/
void zhongduan0() interrupt 0
{
    led = 0;                         // 中断状态指示
	key = 1;                    
	while(!key);                    // 按下按钮中断数码管变动  松开退出中断程序 数码管继续快速变动
}