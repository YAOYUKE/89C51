#include "reg52.h"
#include "intrins.h"


/*************************************************************************
- Function    : 流水灯实验
- Description : 硬件连接：LED0-LED7 -> P1.0-P1.7
- Author      : Y.
- Date        : 2017.12
 *************************************************************************/
 
 
/* 定义常用变量类型 */
typedef unsigned char u8;
typedef unsigned int u16;


/* 声明子函数 */
void delay(u16);

/*************************************************************************
 Function    : 主程序
 Description : None 
**************************************************************************/
void main()
{
	u8 i,rol;
	rol = 0xfe;                               // 1111 1110
	
	while(1)
	{
		for(i=0;i<8;i++)
		{
			P1 = rol;
			delay(200);                        // 延时 200 ms
			rol = _crol_(rol,1);               // 循环左移1位
		}		 
	}
}

/*************************************************************************
 Function    : 延时子程序
 Description : 延时 x 毫秒
**************************************************************************/
void delay(u16 xms)
{
	u16 x,y;
	for(x=xms;x>0;x--)
	{
		for(y=125;y>0;y--);
  	}
}