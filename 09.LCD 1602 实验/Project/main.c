#include <reg52.h>


/*************************************************************************
- Function    : LCD1602 滚动显示字符
- Description : 第一行 右侧移入 Hello Everyone！
                同时第二行 左侧移入 Welcome To Here！然后停留在屏幕上
- Hardware    : LCD EN - P3.5  LCD RS - P3.5
- Author      : Y.
- Date        : 2017.12
 *************************************************************************/
 
 
/* 定义常用变量类型 */
typedef unsigned char u8;
typedef unsigned int u16;

/* 位变量声明 */
sbit lcden = P3^4;                                 // 液晶 使能端
sbit lcdrs = P3^5;                                 // 液晶 数据/命令 选择端

/* 全局变量 */
u8 code line1[] = "Hello EveryOne!";
u8 code line2[] = "Welcome To Here!";
u8 num;

/* 声明子函数 */
void delay(u16);
void init();
void write_com(u8);
void write_data(u8);


/*************************************************************************
 Function    : 主程序
 Description : None 
**************************************************************************/							 
void main()
{
	init();
	write_com(0x80+0x10);                           // 写在第一行 非显示区
	for(num=0;num<15;num++)
	{
		write_data(line1[num]);
		delay(5);
	}

	write_com(0x80+0x50);                           // 写在第二行 非显示区
	for(num=0;num<16;num++)
	{
		write_data(line2[num]);
		delay(5);
	}

	for(num=0;num<16;num++)
	{
		write_com(0x18);                            // 利用整屏左移指令 左移16个字符
		delay(100);                                 // 左移速度
	}
	while(1);
}

/*************************************************************************
 Function    : LCD 命令写入
 Description : NONE
**************************************************************************/
void write_com(u8 com)
{
	lcdrs = 0;                                      // 选择 写命令 模式
	P0 = com;                                       // 将 命令 送入数据总线
	delay(5);                                       // 稍作延时 等待数据稳定
	lcden = 1;                                      // 使能 高脉冲 （初始化置0）
	delay(5);                                       // 延时
	lcden = 0;                                      // 使能 置0 完成高脉冲
}

/*************************************************************************
 Function    : LCD 数据写入
 Description : NONE
**************************************************************************/
void write_data(u8 date)
{
	lcdrs = 1;                                      // 选择 写数据 模式
	P0 = date;                                      // 将 数据 送入数据总线
	delay(5);                                       // 稍作延时 等待数据稳定
	lcden = 1;                                      // 使能 高脉冲 （初始化置0）
	delay(5);                                       // 延时
	lcden = 0;                                      // 使能 置0 完成高脉冲
}
	
/*************************************************************************
 Function    : 初始化子程序
 Description : NONE
**************************************************************************/
void init()
{
	lcden = 0;
	write_com(0x38);                                // 设置  (0x38) 16*2显示 5*7点阵 8位数据口    //不设置默认显示一行
	write_com(0x0c);                                // 设置  (1111) 1.开显示  2.显示光标    //(X0XX) 关显示  (1110) 光标显示但不闪烁  (1101)  光标不显示但闪烁
	write_com(0x06);                                // 设置  (0110) 1.写一个字符指针加一  2.显示不移动
	write_com(0x01);                                // 显示清屏  指针清屏
}

/*************************************************************************
 Function    : 延时子程序
 Description : NONE
**************************************************************************/
void delay(u16 xms)
{
	u16 x,y;
	for(x=xms;x>0;x--)
	{
		for(y=125;y>0;y--);
	}
}