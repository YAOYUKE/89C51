#include "reg52.h"


/*************************************************************************
- Function    : 定时器中断实验
- Description : 定时器1控制LED闪烁  定时器2控制数码管显示秒表
- Hardware    : LED - P1.0  位选 - P2.7  段选 - P2.6
- Author      : Y.
- Date        : 2017.12
 *************************************************************************/


/* 定义常用变量类型 */
typedef unsigned char u8;
typedef unsigned int u16;

/* 位变量声明 */
sbit dula = P2^6;                            // 段选
sbit wela = P2^7;                            // 位选
sbit led = P1^0;                             // LED

/* 定义全局变量 */
u8 code table[]={0x3f,0x06,0x5b,0x4f,
                 0x66,0x6d,0x7d,0x07,
                 0x7f,0x6f,0x77,0x7c,
                 0x39,0x5e,0x79,0x71};
u8 num,num1,num2,shi,ge;
				 
/* 声明子函数 */
void delay(u16);
void display(u8,u8);
				 
				 
/*************************************************************************
 Function    : 主程序
 Description : None 
**************************************************************************/
void main()
{
      EA = 1;                           // 设置中断允许寄存器：1.打开中断总开关
	  ET0 = 1;                          // 设置中断允许寄存器：2.打开定时器0
	  ET1 = 1;                          // 设置中断允许寄存器：2.打开定时器1
	  TMOD = 0x11;                      // 设置工作方式寄存器TMOD：工作方式1 -> 0x01 
	  TH0 = (65536-50000)/256;          // 设置定时器0定时时间50000us
	  TL0 = (65536-50000)%256;          // 
	  TH1 = (65536-50000)/256;          // 设置定时器1定时时间50000us
	  TH1 = (65536-50000)%256;          // 
	  TR0 = 1;                          // 设置控制寄存器：启动定时器0
	  TR1 = 1;                          // 设置控制寄存器：启动定时器0
	
	  while(1)
		{
		    display(shi,ge);
		}
}


/*************************************************************************
 Function    : 数码管显示程序
 Description : 11111111 -> FFFFFFFF 快速变动
**************************************************************************/
void display(u8 shi,u8 ge)
{
    dula = 1;
	  P0 = table[shi];       // 秒表十位显示
	  dula = 0;

	  wela = 1;
	  P0 = 0xfe;
	  wela = 0;
	  delay(5);  
	
	  P0 = 0x00;             // 延时函数之后消影
	
	  dula = 1;
	  P0 = table[ge];        // 秒表个位显示
	  dula = 0;

	  wela = 1;
	  P0 = 0xfd;
	  wela = 0;
	  delay(5);
	
    P0 = 0x00;               //  延时函数之后消影
}


/*************************************************************************
 Function    : 延时子程序
 Description : 延时 x 毫秒
**************************************************************************/
void delay(u16 xms)
{
    int x,y;
	  for(x=xms;x>0;x--)
	  {
		    for(y=125;y>0;y--);
		}
}	


/*************************************************************************
 Function    : 定时器1
 Description : 控制LED闪烁
**************************************************************************/
void T0_time() interrupt 1
{
    TH0 = (65536-50000)/256;
	  TL0 = (65536-50000)%256;
	  num1++;
	  if(num1 == 4)
		{
		    num1 = 0;
			  led = ~led;                // LED闪烁
		}
}


/*************************************************************************
 Function    : 定时器2
 Description : 控制数码管
**************************************************************************/
void T1_time() interrupt 3
{
    TH1 = (65536-50000)/256;
	  TL1 = (65536-50000)%256;
	  num2++;
	  if(num2 == 20)                    // 50ms * 20 = 1s
		{
		    num2 = 0;
			  num++;
			  if(num == 60)             // 60s
				num = 0;
				
				shi = num/10;           // 得到秒表十位
				ge = num%10;            // 得到秒表个位
				
		}
}