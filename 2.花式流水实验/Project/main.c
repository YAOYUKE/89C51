#include "reg52.h"
#include "intrins.h"


/*************************************************************************
- Function    : 花式流水实验
- Description : 间隔300ms先奇数亮再偶数亮，然后再循环三次：
                ①一个LED上下循环三次  ②分别从两边往中间流动三次
								③8个LED全部闪烁3次；关闭LED。
- Hardware    : 硬件连接：LED0-LED7 -> P1.0-P1.7
- Author      : Y.
- Date        : 2017.12
 *************************************************************************/


/* 定义常用变量类型 */
#define u8 unsigned char
#define u16 unsigned int

/* 定义变量 */
u8 code tab[] = {0x7e,0xbd,0xdb,0xe7};

/* 声明子函数 */
void target1();
void target2();
void target3();
void delay(u16);

/*************************************************************************
 Function    : 主程序
 Description : None 
**************************************************************************/
void main()
{
	  while(1)
		{
		   target1();
			 delay(300);
       target2();
			 delay(300);
       target3();	
       delay(300);			
		}
}


/*************************************************************************
 Function    : 延时子程序
 Description : 延时 x 毫秒
**************************************************************************/
void delay(u16 xms)
{
    u16 x,y;
	  for(x=xms;x>0;x--)
	  {
	      for(y=125;y>0;y--);
  	}
}


/*************************************************************************
 Function    : 功能一
 Description : 奇数亮再偶数亮，循环三次
**************************************************************************/
void target1()
{
	  u8 i;
    for(i=0;i<3;i++)
		{
		    P1 = 0xaa;
			  delay(300);
			  P1 = 0x55;
			  delay(300);
		}
		P1 = 0xff;
}


/*************************************************************************
 Function    : 功能二
 Description : LED分别从两边往中间流动三次
**************************************************************************/
void target2()
{
	  u8 i,j,temp,a,b,num;
	  temp = 0xfe;
	
    for(i=0;i<3;i++)
		{
			  for(j=0;j<8;j++)
        {
		        P1 = temp;
            delay(300);
            temp = _crol_(temp,1);             // 循环左移1位
				}					
		}
		P1 = 0xff;
		delay(300);
		
		
		for(a=0;a<3;a++)
		{
			  num = 0;
			  for(b=0;b<4;b++)
				{
		        P1 = tab[num];
			      delay(300);
		  	    num++;
				}
		}
		P1 = 0xff;
}


/*************************************************************************
 Function    : 功能三
 Description : 8个LED全部闪烁3次；关闭LED
**************************************************************************/
void target3()
{
	  u8 c;
    for(c=0;c<3;c++)
		{
		    P1 = 0x00;
			  delay(300);
			  P1 = 0xff;
			  delay(300);
		}
		
		P1 = 0xff;                                  // 最后关闭所有LED
}

